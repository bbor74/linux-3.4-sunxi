## drivers/input/inet_touchscreen/Kconfig
```kconfig
#
# Touchscreen driver configuration
#
menuconfig INPUT_TOUCHSCREEN
	bool "Touchscreens"
	help
	  Say Y here, and a list of supported touchscreens will be displayed.
	  This option doesn't affect the kernel.

	  If unsure, say Y.

if INPUT_TOUCHSCREEN

#source "drivers/input/inet_touchscreen/ft5x/Kconfig"
#source "drivers/input/inet_touchscreen/ft5402/Kconfig"
source "drivers/input/inet_touchscreen/gslx680/Kconfig"
source "drivers/input/inet_touchscreen/gslx680new/Kconfig"
#source "drivers/input/inet_touchscreen/gt9xx/Kconfig"
#source "drivers/input/inet_touchscreen/gt9xxf/Kconfig"


endif
```
